#include "networking.h"

void syncTimeFromNTP();
void drawStaticElements();

#include <WiFi.h>
#include <HTTPClient.h>
#include <Arduino_JSON.h>
#include "EPD.h"
#include "pic.h"
#include "config.h"

#include <time.h>

#include "EPD_Init.h"
#define EPD_IMAGE_BUFFER_SIZE ((EPD_W * EPD_H) / 8)
static_assert(EPD_IMAGE_BUFFER_SIZE <= 15000, "EPD_IMAGE_BUFFER_SIZE exceeds available memory!");
uint8_t ImageBW[EPD_IMAGE_BUFFER_SIZE];

String jsonBuffer;
int httpResponseCode;
JSONVar myObject;

String temperature;
String humidity;
String city_js;

String serverPath = "http://api.openweathermap.org/data/2.5/weather?q=" WEATHER_CITY "," WEATHER_COUNTRY_CODE "&APPID=" OPENWEATHERMAP_API_KEY "&units=metric";

void syncTimeFromNTP() {
  configTime(0, 0, NTP_SERVER);
  delay(3000);
  time_t now = time(nullptr);
  if (now < NTP_MIN_VALID_TIME) {
    delay(2000);
    now = time(nullptr);
  }
}

void drawStaticElements() {
  EPD_DrawLine(0, POS_DIVIDER_Y, EPD_W, POS_DIVIDER_Y, BLACK);
  EPD_ShowPicture(POS_TEMP_ICON_X, POS_TEMP_ICON_Y, PIC_TEMP_X, PIC_TEMP_Y, gImage_pic_temp1, WHITE);
  EPD_ShowPicture(POS_HUMI_ICON_X, POS_HUMI_ICON_Y, PIC_HUMI_X, PIC_HUMI_Y, gImage_pic_humi, WHITE);
  EPD_Display(ImageBW);
  EPD_Update();
}

void setup() {
  Serial.begin(115200);

  pinMode(DISPLAY_POWER_PIN, OUTPUT);
  digitalWrite(DISPLAY_POWER_PIN, HIGH);

  if (!connectWiFiWithBackoff(WIFI_MAX_RETRIES)) {
    while (true) {
      delay(5000);
      connectWiFiWithBackoff(WIFI_MAX_RETRIES);
    }
  }

  syncTimeFromNTP();
  js_analysis();

  EPD_GPIOInit(); 
  EPD_Init();
  EPD_Clear(); 
  EPD_Update();     
                    
  Paint_NewImage(ImageBW, EPD_W, EPD_H, 0, WHITE); 
  Paint_Clear(WHITE); 
  EPD_Display(ImageBW);
  EPD_Clear_R26H(ImageBW);
  EPD_Update();
  drawStaticElements();
  Update_Display(); 
}

void loop() {
  static unsigned long lastWeatherUpdate = 0;
  static unsigned long lastFullRefresh = 0;
  unsigned long now = millis();

  ensureWiFiConnected();
  syncTimeFromNTP();

  if (now - lastFullRefresh >= FULL_REFRESH_INTERVAL_MS) {
    EPD_Clear();
    EPD_Update();
    Paint_NewImage(ImageBW, EPD_W, EPD_H, 0, WHITE);
    Paint_Clear(WHITE);
    drawStaticElements();
    lastFullRefresh = now;
  }

  if (now - lastWeatherUpdate >= WEATHER_UPDATE_INTERVAL_MS) {
    jsonBuffer = httpGETRequest(serverPath.c_str());
    js_analysis();
    lastWeatherUpdate = now;
  }

  Update_Display();
  delay(UPDATE_INTERVAL_MS);
}

void clear_all() {
  EPD_Clear();               
  Paint_NewImage(ImageBW, EPD_W, EPD_H, 0, WHITE);
  Paint_Clear(WHITE);            
  EPD_Display_Part(0, 0, EPD_W, EPD_H, ImageBW); 
}

void Update_Display() {
  time_t t;
  time(&t);

  time_t ist_time = t + (long)TIMEZONE_IST_OFFSET_SEC;
  struct tm ist_tm;
  gmtime_r(&ist_time, &ist_tm);

  time_t london_time = t + (long)TIMEZONE_LONDON_OFFSET_SEC;
  struct tm london_tm;
  gmtime_r(&london_time, &london_tm);

  Serial.println("----------The screen time display is about to refresh----------");
  delay(1000);
  Serial.print("IST: ");
  Serial.println(asctime(&ist_tm));
  Serial.print("London: ");
  Serial.println(asctime(&london_tm));

  int ist_hour = ist_tm.tm_hour;
  const char *ist_ampm = (ist_hour >= 12) ? "PM" : "AM";
  if (ist_hour > 12) ist_hour -= 12;
  if (ist_hour == 0) ist_hour = 12;

  int london_hour = london_tm.tm_hour;
  const char *london_ampm = (london_hour >= 12) ? "PM" : "AM";
  if (london_hour > 12) london_hour -= 12;
  if (london_hour == 0) london_hour = 12;

  static char buff_ist[40];
  static char buff_london[40];
  static char buff_date[40];
  char buffer[80];
  sprintf(buff_ist, "%02d:%02d", ist_hour, ist_tm.tm_min);
  sprintf(buff_london, "%02d:%02d", london_hour, london_tm.tm_min);
  sprintf(buff_date, "%02d-%02d-%04d", ist_tm.tm_mday, ist_tm.tm_mon + 1, ist_tm.tm_year + 1900);

  const char *daysOfWeek[] = {"Sunday", "Monday", "Tuesday", "Wednesday", "Thursday", "Friday", "Saturday"};
  const char *dayOfWeek = daysOfWeek[ist_tm.tm_wday];

  Paint_NewImage(ImageBW, EPD_W, EPD_H, 0, WHITE);
  Paint_Clear(WHITE);

  EPD_DrawLine(0, POS_DIVIDER_Y, EPD_W, POS_DIVIDER_Y, BLACK);
  EPD_DrawLine(POS_DIVIDER_X, POS_CLOCK_DIVIDER_TOP, POS_DIVIDER_X, POS_CLOCK_DIVIDER_BOTTOM, BLACK);
  EPD_ShowPicture(POS_TEMP_ICON_X, POS_TEMP_ICON_Y, PIC_TEMP_X, PIC_TEMP_Y, gImage_pic_temp1, WHITE);
  EPD_ShowPicture(POS_HUMI_ICON_X, POS_HUMI_ICON_Y, PIC_HUMI_X, PIC_HUMI_Y, gImage_pic_humi, WHITE);

  EPD_ShowString(POS_DATE_X, POS_DATE_Y, buff_date, FONT_DATE_SIZE, BLACK);
  EPD_ShowString(POS_IST_LABEL_X, POS_IST_LABEL_Y, "IST", FONT_LABEL_SIZE, BLACK);
  EPD_ShowString(POS_UKT_LABEL_X, POS_UKT_LABEL_Y, "UKT", FONT_LABEL_SIZE, BLACK);
  EPD_ShowString(POS_TIME_IST_X, POS_TIME_IST_Y, buff_ist, FONT_TIME_SIZE, BLACK);
  EPD_ShowString(POS_TIME_LONDON_X, POS_TIME_LONDON_Y, buff_london, FONT_TIME_SIZE, BLACK);
  EPD_ShowString(POS_AMPM_IST_X, POS_AMPM_IST_Y, ist_ampm, FONT_AMPM_SIZE, BLACK);
  EPD_ShowString(POS_AMPM_LONDON_X, POS_AMPM_LONDON_Y, london_ampm, FONT_AMPM_SIZE, BLACK);
  EPD_ShowString(POS_DAY_X, POS_DAY_Y, dayOfWeek, FONT_DAY_SIZE, BLACK);

  memset(buffer, 0, sizeof(buffer));
  snprintf(buffer, sizeof(buffer), "%s C", temperature.c_str());
  EPD_ShowString(POS_TEMP_TEXT_X, POS_TEMP_TEXT_Y, buffer, FONT_WEATHER_SIZE, BLACK);
  memset(buffer, 0, sizeof(buffer));
  snprintf(buffer, sizeof(buffer), "%s %%", humidity.c_str());
  EPD_ShowString(POS_HUMI_TEXT_X, POS_HUMI_TEXT_Y, buffer, FONT_WEATHER_SIZE, BLACK);
  Serial.println("* * * * * * The screen time display has been refreshed * * * * * *");

  EPD_Display(ImageBW);
  EPD_Update_Part();
}

void js_analysis() {
  if (WiFi.status() != WL_CONNECTED) {
    return;
  }

  uint8_t attempts = 0;
  while (attempts < WEATHER_FETCH_MAX_RETRIES) {
    jsonBuffer = httpGETRequest(serverPath.c_str());
    if (httpResponseCode != 200) {
      attempts++;
      delay(1000);
      continue;
    }

    myObject = JSON.parse(jsonBuffer);
    if (JSON.typeof(myObject) == "undefined") {
      attempts++;
      delay(1000);
      continue;
    }

    temperature = JSON.stringify(myObject["main"]["temp"]);
    humidity = JSON.stringify(myObject["main"]["humidity"]);
    city_js = JSON.stringify(myObject["name"]);
    return;
  }
}

String httpGETRequest(const char* serverName) {
  WiFiClient client;
  HTTPClient http;
  String payload = "{}";

  http.begin(client, serverName);
  httpResponseCode = http.GET();

  if (httpResponseCode == 200) {
    payload = http.getString();
  } else {
    Serial.print("HTTP error: ");
    Serial.println(httpResponseCode);
  }

  http.end();
  return payload;
}
